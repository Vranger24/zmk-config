#include "vkey29.dtsi"

/* Right half: columns 0-6 on this MCU map to logical columns 7-13 in the full keymap */
&default_transform {
    col-offset = <7>;
};

&kscan0 {
    row-gpios = <
        &gpio0 5  (GPIO_ACTIVE_LOW | GPIO_PULL_UP)  /* num */
        &gpio0 6  (GPIO_ACTIVE_LOW | GPIO_PULL_UP)  /* top */
        &gpio0 7  (GPIO_ACTIVE_LOW | GPIO_PULL_UP)  /* home */
        &gpio0 8  (GPIO_ACTIVE_LOW | GPIO_PULL_UP)  /* bottom */
        &gpio0 9  (GPIO_ACTIVE_LOW | GPIO_PULL_UP)  /* thumb */
    >;

    col-gpios = <
        &gpio0 21 (GPIO_ACTIVE_LOW | GPIO_PULL_UP)  /* outer */
        &gpio0 20 (GPIO_ACTIVE_LOW | GPIO_PULL_UP)  /* pinky */
        &gpio0 19 (GPIO_ACTIVE_LOW | GPIO_PULL_UP)  /* ring */
        &gpio0 18 (GPIO_ACTIVE_LOW | GPIO_PULL_UP)  /* middle */
        &gpio0 15 (GPIO_ACTIVE_LOW | GPIO_PULL_UP)  /* index */
        &gpio0 14 (GPIO_ACTIVE_LOW | GPIO_PULL_UP)  /* inner */
        &gpio0 16 (GPIO_ACTIVE_LOW | GPIO_PULL_UP)  /* thumbspace */
    >;
};