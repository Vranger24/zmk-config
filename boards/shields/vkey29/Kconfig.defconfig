## boards/shields/vkey29/Kconfig.defconfig
```kconfig
# VKey29 split shield: left = central, right = peripheral
if SHIELD_VKEY29_LEFT

config ZMK_KEYBOARD_NAME
    default "VKey29"

config ZMK_SPLIT_ROLE_CENTRAL
    default y

endif

if SHIELD_VKEY29_LEFT || SHIELD_VKEY29_RIGHT

config ZMK_SPLIT
    default y

endif
```

## boards/shields/vkey29/Kconfig.shield
```kconfig
# No whitespace after the comma or in shield names (ZMK guideline)
config SHIELD_VKEY29_LEFT
    def_bool $(shields_list_contains,vkey29_left)

config SHIELD_VKEY29_RIGHT
    def_bool $(shields_list_contains,vkey29_right)
```
